/*********************************************************************************************************
* 模块名称: task.c
* 摘    要:
* 当前版本: 1.0.0
* 作    者: Oron
* 创建日期: 2025-11-24
* 内    容:
* 注    意:
**********************************************************************************************************
* 取代版本:
* 作    者:
* 完成日期:
* 修改内容:
* 修改文件:
*********************************************************************************************************/

/*********************************************************************************************************
*                                              包含头文件
*********************************************************************************************************/
#include "main.h"
#include "tim.h"
#include "iwdg.h"
/*********************************************************************************************************
*                                              宏定义
*********************************************************************************************************/

/*********************************************************************************************************
*                                              全局变量
*********************************************************************************************************/
extern volatile uint8_t KEY_STATUS;
extern volatile uint8_t KEY_STATUS_2;
/*********************************************************************************************************
*                                              枚举结构体定义
*********************************************************************************************************/

/*********************************************************************************************************
*                                              内部变量
*********************************************************************************************************/

/*********************************************************************************************************
*                                              内部函数声明
*********************************************************************************************************/
void OutPut_Events(void);
/*********************************************************************************************************
*                                              API函数实现
*********************************************************************************************************/
/*********************************************************************************************************
* 函数名称:
* 函数功能:
* 输入参数: void
* 输出参数: void
* 返 回 值: void
* 创建日期: 2025-11-24
* 注    意:
*********************************************************************************************************/
void Task_20ms_DIV(void)
{
    static uint8_t Branch_4ms = 0;
    //............................

    if (Flag_Main_4ms == 0)
        return;

    Flag_Main_4ms = 0;
	
    //............................
    IWDG_Feed();
//	KEY_STATUS = Key_Scan();
    //............................
	

    switch (++Branch_4ms)
    {
        case 1: 
			Timer_Program();
            break;
        case 2: 
			OutPut_Events();
            break;
        case 3:
            break;
        case 4:
            break;
        case 5:
            Branch_4ms = 0;
            break;
        default:
            Branch_4ms = 0;
            break;
        }
}

/*********************************************************************************************************
* 函数名称:
* 函数功能:
* 输入参数: void
* 输出参数: void
* 返 回 值: void
* 创建日期: 2025-11-24
* 注    意:
*********************************************************************************************************/
void HAL_TIM_PeriodElapsedCallback(TIM_HandleTypeDef *htim)
{
	static uint8_t Time4ms_cnt;
	
    if(htim == &htim4)
    {
        if (++Time4ms_cnt >= 32)
        {
            Time4ms_cnt = 0;
            Flag_Main_4ms = 1;
        }
    }
}

/*********************************************************************************************************
* 函数名称: User_Init
* 函数功能:
* 输入参数: void
* 输出参数: void
* 返 回 值: void
* 创建日期: 2025-03-17
* 注    意:
*********************************************************************************************************/
void User_Init(void)
{
	HAL_TIM_Base_Start_IT(&htim4);
}
/*********************************************************************************************************
*                                              内部函数实现
*********************************************************************************************************/
/*********************************************************************************************************
* 函数名称: OutPut_Events
* 函数功能: 输出
* 输入参数: void
* 输出参数: void
* 返 回 值: void
* 创建日期: 2025-06-19
* 注    意:
*********************************************************************************************************/
void OutPut_Events(void)
{
	//Buzzer_Event();
}

