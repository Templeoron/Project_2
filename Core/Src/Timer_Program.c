/*********************************************************************************************************
* 模块名称: Timer_Program.c
* 摘    要:
* 当前版本: 1.0.0
* 作    者: Oron
* 创建日期: 2025-11-25
* 内    容:
* 注    意:
**********************************************************************************************************
* 取代版本:
* 作    者:
* 完成日期:
* 修改内容:
* 修改文件:
*********************************************************************************************************/

/*********************************************************************************************************
*                                              包含头文件
*********************************************************************************************************/
#include "Define_Global.h"
#include "usart.h"
/*********************************************************************************************************
*                                              宏定义
*********************************************************************************************************/

/*********************************************************************************************************
*                                              全局变量
*********************************************************************************************************/

/*********************************************************************************************************
*                                              枚举结构体定义
*********************************************************************************************************/
typedef struct
{
    uint8_t Sec;
    uint8_t Drive;
    uint16_t Min;
}TIME;

TIME Time;
/*********************************************************************************************************
*                                              内部变量
*********************************************************************************************************/
uint8_t temperature = 1;  //温度
uint8_t humidity = 1;     //湿度
uint8_t aTXbuf[32];       //串口发送缓存数组
/*********************************************************************************************************
*                                              内部函数声明
*********************************************************************************************************/
void Drive_20ms_Events(void);
void Beep_Cnt_Event(void);
void HCSR04_Event(void);
/*********************************************************************************************************
*                                              API函数实现
*********************************************************************************************************/
/*********************************************************************************************************
* 函数名称:
* 函数功能:
* 输入参数: void
* 输出参数: void
* 返 回 值: void
* 创建日期: 2025-11-25
* 注    意:
*********************************************************************************************************/
void Timer_Program(void)
{
    Time.Sec++;
    Time.Min++;
    Time.Drive++;
	
	//20ms
	Drive_20ms_Events();

	//1s------------------------//
    if(Time.Sec >= 50)
    {
        Time.Sec = 0;
		Flag_DisplayAll = 1;
    }

	//1min------------------------//
    if(Time.Min >= 3000)
    {
        Time.Min = 0;
        
    }

    if((Time.Drive % 25) == 0)
    {
        Time.Drive = 0;
		Flag_Time_500ms = !Flag_Time_500ms;
		
		if(Flag_Time_500ms)
		{
//			DHT11_Read_Data(&temperature , &humidity);
//			sprintf((char*)aTXbuf,"温度：%d℃，湿度: %d %%\r\n" ,temperature ,humidity);
//			HAL_UART_Transmit(&huart1, aTXbuf, strlen((const char*)aTXbuf), 200);
		}
    }
}
/*********************************************************************************************************
*                                              内部函数实现
*********************************************************************************************************/
/*********************************************************************************************************
* 函数名称: Drive_20ms_Events
* 函数功能: 4ms计数函数
* 输入参数: void
* 输出参数: void
* 返 回 值: void
* 创建日期: 2025-06-19
* 注    意:
*********************************************************************************************************/
void Drive_20ms_Events(void)
{
	Beep_Cnt_Event();
    HCSR04_Event();
}

/*********************************************************************************************************
* 函数名称: Beep_Cnt_Event
* 函数功能: 蜂鸣器计数函数
* 输入参数: void
* 输出参数: void
* 返 回 值: void
* 创建日期: 2025-06-19
* 注    意:
*********************************************************************************************************/
void Beep_Cnt_Event(void)
{
	if(Cnt.Beep)
	{
		Cnt.Beep--;
		if(!Cnt.Beep)Flag_BeepEn = 0;
	}
}

/*********************************************************************************************************
* 函数名称:
* 函数功能:
* 输入参数: void
* 输出参数: void
* 返 回 值: void
* 创建日期: 2025-07-13
* 注    意:
*********************************************************************************************************/
void HCSR04_Event(void)
{
    static uint8_t i;
    if(++i >= 5)
    {
        i = 0;
        //HS_SC04_Event();
    }
}
